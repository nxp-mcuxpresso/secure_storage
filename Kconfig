## Kconfig
```kconfig
# Copyright 2025 NXP
# Copyright (c) 2024 Nordic Semiconductor
# SPDX-License-Identifier: Apache-2.0

menuconfig MCUX_COMPONENT_middleware.SECURE_STORAGE
	bool "Secure storage subsystem"
	help
	  The secure storage subsystem provides an implementation of the PSA Secure Storage API
	  functions on board targets that don't already have one.
	  It allows making use of the PSA Secure Storage API and persistent keys in the PSA Crypto
	  API in a standard and portable way.
	  It is configurable and different implementations can be used to accommodate the varying
	  capabilities of different devices.
	  In addition to providing functional support for the PSA Secure Storage API, depending on
	  the device-specific security features that are available and used, the subsystem may
	  secure the data stored through it at rest.
	  This is however highly dependent on the device and configuration in use, and not a
	  guarantee of the subsystem.

if MCUX_COMPONENT_middleware.SECURE_STORAGE

config SECURE_STORAGE_64_BIT_UID
	bool "Make psa_storage_uid_t 64-bit"
	help
	  Zephyr, by default, uses a 30-bit psa_storage_uid_t, which allows using only 32 bits to
	  identify entries.
	  UID ranges are defined for the different users of the API which guarantees that all the
	  UIDs fit within 30 bits. See for example the zephyr/psa/key_ids.h header file.
	  Enable this for backward compatibility if you are updating an existing installation with
	  stored entries that was using Zephyr prior to 4.3 or if for some reason you need the full
	  64-bit UID range.

    choice MCUX_COMPONENT_middleware.SECURE_STORAGE_ITS_IMPLEMENTATION
	prompt "Internal Trusted Storage (ITS) API implementation"

        config MCUX_COMPONENT_middleware.SECURE_STORAGE_ITS_IMPLEMENTATION
	    bool "ITS implementation with Transform and store"
	    select MCUX_COMPONENT_middleware.SECURE_STORAGE_ITS_STORE_MODULE
	    select MCUX_COMPONENT_middleware.SECURE_STORAGE_ITS_TRANSFORM_MODULE

        config MCUX_COMPONENT_middleware.SECURE_STORAGE_ITS_IMPLEMENTATION_WITH_ONLY_STORE
	    bool "ITS implementation with store"
	    select MCUX_COMPONENT_middleware.SECURE_STORAGE_ITS_STORE_MODULE
	    help
	      A ITS API implementation with storage only. This is for implementations
	      where security subsystem takes care of condifentiality and integrity of
	      data to be stored. This implementation dumps the data to be stored into storage
	      medium without any transformation.

    endchoice # MCUX_COMPONENT_middleware.SECURE_STORAGE_ITS_IMPLEMENTATION

config SECURE_STORAGE_ITS_MAX_DATA_SIZE
	int "Maximum data size of an ITS entry in bytes"
	default 128
	help
	  The maximum size, in bytes, that the data of an ITS entry can be.
	  Increasing this value increases the stack usage when serving PSA ITS API calls.

menuconfig MCUX_COMPONENT_middleware.SECURE_STORAGE_ITS_TRANSFORM_MODULE
	bool "ITS transform module"
	help
	  The module that handles the transformation and validation of the
	  ITS data before it's written to and after it's read from NVM.
	  The transform module is from Zephyr.

if MCUX_COMPONENT_middleware.SECURE_STORAGE_ITS_TRANSFORM_MODULE
rsource "zephyr/subsys/secure_storage/Kconfig.its_transform"
endif

menuconfig MCUX_COMPONENT_middleware.SECURE_STORAGE_ITS_STORE_MODULE
	bool "ITS store module"
	help
	  The module that handles the storage/retrieval of the ITS data to/from NVM.

if MCUX_COMPONENT_middleware.SECURE_STORAGE_ITS_STORE_MODULE
rsource "src/its/store/Kconfig.its_store"
endif

endif # MCUX_COMPONENT_middleware.SECURE_STORAGE
```

## src/its/store/Kconfig.its_store
```kconfig
# Copyright (c) 2024 Nordic Semiconductor
# Copyright (c) 2025 NXP Semiconductor
# SPDX-License-Identifier: Apache-2.0

choice SECURE_STORAGE_ITS_STORE_IMPLEMENTATION
	prompt "ITS store module implementation"

config MCUX_COMPONENT_middleware.SECURE_STORAGE_ITS_STORE_IMPLEMENTATION_FATFS
	bool "FATFS based ITS store module implementation"
	
config MCUX_COMPONENT_middleware.SECURE_STORAGE_ITS_STORE_IMPLEMENTATION_LITTLEFS
	bool "LittleFS based ITS store module implementation"

config MCUX_COMPONENT_middleware.SECURE_STORAGE_ITS_STORE_IMPLEMENTATION_SETTINGS
	bool "NVS based ITS store module implementation"

config MCUX_COMPONENT_middleware.SECURE_STORAGE_ITS_STORE_IMPLEMENTATION_CUSTOM
	bool "Custom ITS store module implementation"
	help
	  Implement the functions declared in <zephyr/secure_storage/its/store.h>.
	  The header is made available when this Kconfig option is enabled.

endchoice # SECURE_STORAGE_ITS_STORE_IMPLEMENTATION

if MCUX_COMPONENT_middleware.SECURE_STORAGE_ITS_STORE_IMPLEMENTATION_FATFS

config SECURE_STORAGE_ITS_STORE_FATFS_PREFIX
        string "Subdir in which to store the files, with a trailing slash. Can be empty."
        default "its/"
	help
          Provides folder name where ITS storage will be created on fatfs
          Macro value is in quotes

endif # SECURE_STORAGE_ITS_STORE_IMPLEMENTATION_FATFS

if MCUX_COMPONENT_middleware.SECURE_STORAGE_ITS_STORE_IMPLEMENTATION_LITTLEFS

config SECURE_STORAGE_ITS_STORE_LITTLEFS_PREFIX
        string "Subdir in which to store the files. Can be empty."
        default "its"
	help
          Provides folder name where ITS storage will be created on littlefs
          Macro value is in quotes

endif # SECURE_STORAGE_ITS_STORE_IMPLEMENTATION_LITTLEFS

if MCUX_COMPONENT_middleware.SECURE_STORAGE_ITS_STORE_IMPLEMENTATION_SETTINGS

config SECURE_STORAGE_ITS_STORE_SETTINGS_NAME_CUSTOM
	bool "Custom naming scheme for the stored settings"
	help
	  This allows to use custom names for the settings that the implementation uses
	  instead of the default naming scheme.
	  When enabling this, implement the secure_storage_its_store_settings_get_name()
	  function declared in <zephyr/secure_storage/its/store/settings_get.h>
	  and set CONFIG_SECURE_STORAGE_ITS_STORE_SETTINGS_NAME_MAX_LEN appropriately.
	  The header file is made available when this Kconfig option is enabled.

config SECURE_STORAGE_ITS_STORE_SETTINGS_PREFIX
	string "Subtree in which to store the settings, with a trailing slash. Can be empty."
	default "\"its/\""
	depends on !SECURE_STORAGE_ITS_STORE_SETTINGS_NAME_CUSTOM

config SECURE_STORAGE_ITS_STORE_SETTINGS_NAME_MAX_LEN
	int "Maximum setting name length"
	range 2 64
	default 0 if SECURE_STORAGE_ITS_STORE_SETTINGS_NAME_CUSTOM
	default 22 if SECURE_STORAGE_64_BIT_UID
	default 14

endif #SECURE_STORAGE_ITS_STORE_IMPLEMENTATION_SETTINGS
```
